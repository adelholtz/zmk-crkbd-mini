## Kconfig
```kconfig
menu "ZMK CRKBD Mini"

config ZMK_BEHAVIOR_ADELHOLTZ
    bool "Enable Adelholtz custom behavior"
    default y
    help
      Enable the custom ZMK behavior used by the corne keymap.

endmenu
```

## config/boards/shields/nice_view_adapter/Kconfig.defconfig
```kconfig
# Copyright (c) 2022 The ZMK Contributors
# SPDX-License-Identifier: MIT

if SHIELD_NICE_VIEW_ADAPTER

if ZMK_DISPLAY

config SPI
    default y

config IL0323
    default y

endif # ZMK_DISPLAY

endif # SHIELD_NICE_VIEW_ADAPTER
```

## dts/bindings/behavior/zmk,behavior-adelholtz-process-record-user.yaml
```yaml
description: Adelholtz custom behavior for process_record_user

compatible: "zmk,behavior-adelholtz-process-record-user"

include: [behavior.yaml]

properties:
  "#binding-cells":
    type: int
    required: true
    const: 1
```

## dts/bindings/behaviors/zmk,apr.yaml
```yaml
description: Adelholtz custom behavior for process_record_user

compatible: "zmk,apr"

include: [one_param.yaml]

properties:
  "#binding-cells":
    type: int
    required: true
    const: 1
```

## dts/bindings/behaviors/zmk,behavior-adelholtz-process-record-user.yaml
```yaml
description: Adelholtz custom behavior for process_record_user

compatible: "zmk,apr"

include: [behavior.yaml]

properties:
  "#binding-cells":
    type: int
    required: true
    const: 1
```
